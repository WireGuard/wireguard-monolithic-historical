## src/Kconfig
```kconfig
config WIREGUARD
	bool "IP: WireGuard secure network tunnel"
	depends on NET && INET
	select NET_UDP_TUNNEL
	select NETFILTER_XT_MATCH_HASHLIMIT
	select NETFILTER
	select NETFILTER_XTABLES
	select NETFILTER_ADVANCED
	select NF_CONNTRACK
	select CRYPTO_BLKCIPHER
	default y
	---help---
	  WireGuard is a secure, fast, and easy to use replacement for IPSec
	  that uses modern cryptography and clever networking tricks. It's
	  designed to be fairly general purpose and abstract enough to fit most
	  use cases, while at the same time remaining extremely simple to
	  configure. See www.wireguard.io for more info.

	  It's safe to say Y or M here, as the driver is very lightweight and
	  is only in use when an administrator chooses to add an interface.

config WIREGUARD_PARALLEL
	bool "Enable parallel engine"
	depends on SMP && WIREGUARD
	select PADATA
	default y
	---help---
	  This will allow WireGuard to utilize all CPU cores when encrypting
	  and decrypting packets.
	  
	  It's safe to say Y here, and you probably should, as the performance
	  improvements are substantial.

config WIREGUARD_DEBUG
	bool "Debugging checks and verbose messages"
	depends on WIREGUARD
	---help---
	  This will write log messages for handshake and other events
	  that occur for a WireGuard interface. It will also perform some
	  extra validation checks and unit tests at various points. This is
	  only useful for debugging.
	  
	  Say N here unless you know what you're doing.
```
